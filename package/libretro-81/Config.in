## package/libretro-81/Config.in
```kconfig
config BR2_PACKAGE_LIBRETRO_81
        bool "libretro-81"
	depends on BR2_PACKAGE_RETROARCH
	depends on BR2_INSTALL_LIBSTDCPP
	select BR2_PACKAGE_RECALBOX_ROMFS_ZX81
        help
          A libretro EightyOne ZX81 emulator core.

	  http://www.libretro.com

comment "LIBRETRO_81 needs a toolchain w/ C++"
	depends on !BR2_INSTALL_LIBSTDCPP
```

## package/libretro-beetle-ngp/Config.in
```kconfig
config BR2_PACKAGE_LIBRETRO_BEETLE_NGP
        bool "libretro-beetle-ngp"
	depends on BR2_PACKAGE_RETROARCH
	depends on BR2_INSTALL_LIBSTDCPP
	select BR2_PACKAGE_RECALBOX_ROMFS_NGP
	select BR2_PACKAGE_RECALBOX_ROMFS_NGPC
        help
          A libretro NGP emulator core for ARM.

	  http://www.libretro.com

comment "LIBRETRO_BEETLE_NGP needs a toolchain w/ C++"
	depends on !BR2_INSTALL_LIBSTDCPP
```

## package/libretro-beetle-pce/Config.in
```kconfig
config BR2_PACKAGE_LIBRETRO_BEETLE_PCE
        bool "libretro-beetle-pce"
	depends on BR2_PACKAGE_RETROARCH
	depends on BR2_INSTALL_LIBSTDCPP
	select BR2_PACKAGE_RECALBOX_ROMFS_PCENGINE
	select BR2_PACKAGE_RECALBOX_ROMFS_PCENGINECD
	select BR2_PACKAGE_RECALBOX_ROMFS_SUPERGRAFX
        help
          A libretro PCE emulator core for ARM.

	  http://www.libretro.com

comment "LIBRETRO_BEETLE_PCE needs a toolchain w/ C++"
	depends on !BR2_INSTALL_LIBSTDCPP
```

## package/libretro-beetle-supergrafx/Config.in
```kconfig
config BR2_PACKAGE_LIBRETRO_BEETLE_SUPERGRAFX
        bool "libretro-beetle-supergrafx"
	depends on BR2_PACKAGE_RETROARCH
	depends on BR2_INSTALL_LIBSTDCPP
	select BR2_PACKAGE_RECALBOX_ROMFS_PCENGINE
	select BR2_PACKAGE_RECALBOX_ROMFS_PCENGINECD
	select BR2_PACKAGE_RECALBOX_ROMFS_SUPERGRAFX
        help
          A libretro Supergrafx emulator core for ARM.

	  http://www.libretro.com

comment "LIBRETRO_BEETLE_SUPERGRAFX needs a toolchain w/ C++"
	depends on !BR2_INSTALL_LIBSTDCPP
```

## package/libretro-bluemsx/Config.in
```kconfig
config BR2_PACKAGE_LIBRETRO_BLUEMSX
        bool "libretro-bluemsx"
	depends on BR2_PACKAGE_RETROARCH
	depends on BR2_INSTALL_LIBSTDCPP
	select BR2_PACKAGE_RECALBOX_ROMFS_COLECOVISION
	select BR2_PACKAGE_RECALBOX_ROMFS_MSX
	select BR2_PACKAGE_RECALBOX_ROMFS_MSX1
	select BR2_PACKAGE_RECALBOX_ROMFS_MSX2
        help
          A libretro MSX / ColecoVision emulator core for ARM.

	  http://www.libretro.com

comment "LIBRETRO_BLUEMSX needs a toolchain w/ C++"
	depends on !BR2_INSTALL_LIBSTDCPP
```

## package/libretro-fba/Config.in
```kconfig
config BR2_PACKAGE_LIBRETRO_FBA
        bool "libretro-fba"
	depends on BR2_PACKAGE_RETROARCH
	depends on BR2_INSTALL_LIBSTDCPP
	select BR2_PACKAGE_RECALBOX_ROMFS_FBA
	select BR2_PACKAGE_RECALBOX_ROMFS_FBA_LIBRETRO
	select BR2_PACKAGE_RECALBOX_ROMFS_NEOGEO
        help
          A libretro fba emulator core for ARM.

	  http://www.libretro.com

comment "LIBRETRO_FBA needs a toolchain w/ C++"
	depends on !BR2_INSTALL_LIBSTDCPP
```

## package/libretro-gpsp/Config.in
```kconfig
config BR2_PACKAGE_LIBRETRO_GPSP
        bool "libretro-gpsp"
	depends on BR2_PACKAGE_RETROARCH
	depends on BR2_INSTALL_LIBSTDCPP
	select BR2_PACKAGE_RECALBOX_ROMFS_GBA
        help
          A libretro GBA emulator core for ARM.

	  http://www.libretro.com

comment "LIBRETRO_GPSP needs a toolchain w/ C++"
	depends on !BR2_INSTALL_LIBSTDCPP
```

## package/libretro-imame/Config.in
```kconfig
config BR2_PACKAGE_LIBRETRO_IMAME
        bool "libretro-imame"
	depends on BR2_PACKAGE_RETROARCH
	depends on BR2_INSTALL_LIBSTDCPP
	select BR2_PACKAGE_RECALBOX_ROMFS_MAME
	select BR2_PACKAGE_RECALBOX_ROMFS_NEOGEO
        help
          A libretro imame4all core for ARM.

	  http://www.libretro.com

comment "LIBRETRO_IMAME needs a toolchain w/ C++"
	depends on !BR2_INSTALL_LIBSTDCPP
```

## package/libretro-lutro/Config.in
```kconfig
config BR2_PACKAGE_LIBRETRO_LUTRO
        bool "libretro-lutro"
	depends on BR2_PACKAGE_RETROARCH
	depends on BR2_INSTALL_LIBSTDCPP
	select BR2_PACKAGE_RECALBOX_ROMFS_LUTRO
        help
          An experimental lua game framework for libretro.

	  http://www.libretro.com

comment "LIBRETRO_LUTRO needs a toolchain w/ C++"
	depends on !BR2_INSTALL_LIBSTDCPP
```

## package/libretro-mame2003/Config.in
```kconfig
config BR2_PACKAGE_LIBRETRO_MAME2003
        bool "libretro-mame2003"
	depends on BR2_PACKAGE_RETROARCH
	depends on BR2_INSTALL_LIBSTDCPP
	select BR2_PACKAGE_RECALBOX_ROMFS_MAME
	select BR2_PACKAGE_RECALBOX_ROMFS_NEOGEO
        help
          A libretro mame2003 core for ARM.

	  http://www.libretro.com

comment "LIBRETRO_MAME2003 needs a toolchain w/ C++"
	depends on !BR2_INSTALL_LIBSTDCPP
```

## package/libretro-nestopia/Config.in
```kconfig
config BR2_PACKAGE_LIBRETRO_NESTOPIA
        bool "libretro-nestopia"
	depends on BR2_PACKAGE_RETROARCH
	depends on BR2_INSTALL_LIBSTDCPP
	select BR2_PACKAGE_RECALBOX_ROMFS_FDS
	select BR2_PACKAGE_RECALBOX_ROMFS_NES
        help
          A libretro NES & FDS emulator core for ARM.

	  http://www.libretro.com

comment "LIBRETRO_NESTOPIA needs a toolchain w/ C++"
	depends on !BR2_INSTALL_LIBSTDCPP
```

## package/libretro-pcsx/Config.in
```kconfig
config BR2_PACKAGE_LIBRETRO_PCSX
        bool "libretro-pcsx"
	depends on BR2_PACKAGE_RETROARCH
	depends on BR2_INSTALL_LIBSTDCPP
	select BR2_PACKAGE_RECALBOX_ROMFS_PSX
        help
          A libretro psx emulator core for ARM.

	  http://www.libretro.com

comment "LIBRETRO_PCSX needs a toolchain w/ C++"
	depends on !BR2_INSTALL_LIBSTDCPP
```

## package/libretro-picodrive/Config.in
```kconfig
config BR2_PACKAGE_LIBRETRO_PICODRIVE
        bool "libretro-picodrive"
	depends on BR2_PACKAGE_RETROARCH
	depends on BR2_INSTALL_LIBSTDCPP
	depends on BR2_PACKAGE_LIBPNG
	depends on BR2_PACKAGE_SDL
	select BR2_PACKAGE_RECALBOX_ROMFS_GAMEGEAR
	select BR2_PACKAGE_RECALBOX_ROMFS_MASTERSYSTEM
	select BR2_PACKAGE_RECALBOX_ROMFS_MEGADRIVE
	select BR2_PACKAGE_RECALBOX_ROMFS_SEGA32X
	select BR2_PACKAGE_RECALBOX_ROMFS_SEGACD
	select BR2_PACKAGE_RECALBOX_ROMFS_SG1000
        help
          A libretro Megadrive SMS emulator core for ARM.

	  http://www.libretro.com

comment "Picodrive needs a toolchain w/ C++"
	depends on !BR2_INSTALL_LIBSTDCPP && !BR2_PACKAGE_LIBPNG
```

## package/libretro-pocketsnes/Config.in
```kconfig
config BR2_PACKAGE_LIBRETRO_POCKETSNES
        bool "libretro-pocketsnes"
	depends on BR2_PACKAGE_RETROARCH
	depends on BR2_INSTALL_LIBSTDCPP
	select BR2_PACKAGE_RECALBOX_ROMFS_SNES
        help
          A libretro SNES emulator core for ARM.

	  http://www.libretro.com

comment "LIBRETRO_POCKETSNES needs a toolchain w/ C++"
	depends on !BR2_INSTALL_LIBSTDCPP
```

## package/libretro-prboom/Config.in
```kconfig
config BR2_PACKAGE_LIBRETRO_PRBOOM
        bool "libretro-prboom"
	depends on BR2_PACKAGE_RETROARCH
	depends on BR2_INSTALL_LIBSTDCPP
	select BR2_PACKAGE_RECALBOX_ROMFS_PRBOOM
        help
          A libretro PrBoom core for ARM.

	  http://www.libretro.com

comment "LIBRETRO_PRBOOM needs a toolchain w/ C++"
	depends on !BR2_INSTALL_LIBSTDCPP
```

## package/libretro-prosystem/Config.in
```kconfig
config BR2_PACKAGE_LIBRETRO_PROSYSTEM
        bool "libretro-prosystem"
	depends on BR2_PACKAGE_RETROARCH
	depends on BR2_INSTALL_LIBSTDCPP
	select BR2_PACKAGE_RECALBOX_ROMFS_ATARI7800
        help
          A libretro ATARI 7800 emulator for ARM.

	  http://www.libretro.com

comment "LIBRETRO_PROSYSTEM needs a toolchain w/ C++"
	depends on !BR2_INSTALL_LIBSTDCPP
```

## package/libretro-quicknes/Config.in
```kconfig
config BR2_PACKAGE_LIBRETRO_QUICKNES
        bool "libretro-quicknes"
	depends on BR2_PACKAGE_RETROARCH
	depends on BR2_INSTALL_LIBSTDCPP
	select BR2_PACKAGE_RECALBOX_ROMFS_NES
        help
          A libretro NES emulator core for ARM.

	  http://www.libretro.com

comment "LIBRETRO_QUICKNES needs a toolchain w/ C++"
	depends on !BR2_INSTALL_LIBSTDCPP
```

## package/libretro-snes9x-next/Config.in
```kconfig
config BR2_PACKAGE_LIBRETRO_SNES9X_NEXT
        bool "libretro-snes9x-next"
	depends on BR2_PACKAGE_RETROARCH
	depends on BR2_INSTALL_LIBSTDCPP
	select BR2_PACKAGE_RECALBOX_ROMFS_SNES
        help
          A libretro SNES emulator core for ARM.

	  http://www.libretro.com

comment "LIBRETRO_SNES9X_NEXT needs a toolchain w/ C++"
	depends on !BR2_INSTALL_LIBSTDCPP
```

## package/libretro-stella/Config.in
```kconfig
config BR2_PACKAGE_LIBRETRO_STELLA
        bool "libretro-stella"
	depends on BR2_PACKAGE_RETROARCH
	depends on BR2_INSTALL_LIBSTDCPP
	select BR2_PACKAGE_RECALBOX_ROMFS_ATARI2600
        help
          A libretro Atari 2600 emulator core for ARM.

	  http://www.libretro.com

comment "LIBRETRO_STELLA needs a toolchain w/ C++"
	depends on !BR2_INSTALL_LIBSTDCPP
```

## package/libretro-tgbdual/Config.in
```kconfig
config BR2_PACKAGE_LIBRETRO_TGBDUAL
        bool "libretro-tgbdual"
	depends on BR2_PACKAGE_RETROARCH
	depends on BR2_INSTALL_LIBSTDCPP
	select BR2_PACKAGE_RECALBOX_ROMFS_GB
	select BR2_PACKAGE_RECALBOX_ROMFS_GBC
        help
          A libretro GB/C emulator core for ARM.

	  http://www.libretro.com

comment "LIBRETRO_TGBDUAL needs a toolchain w/ C++"
	depends on !BR2_INSTALL_LIBSTDCPP
```

## package/ppsspp/Config.in
```kconfig
config BR2_PACKAGE_PPSSPP
        bool "ppsspp"
	depends on BR2_PACKAGE_SDL2
	depends on BR2_PACKAGE_ZLIB
	depends on BR2_PACKAGE_FFMPEG_SWSCALE
	select BR2_PACKAGE_RECALBOX_ROMFS_PSP
        help
          A  PSP emulator
```

## package/pwm-audio-pi-zero/Config.in
```kconfig
config BR2_PACKAGE_PWM_AUDIO_PI_ZERO
	bool "pwm-audio-pi-zero"
	depends on BR2_PACKAGE_RPI_FIRMWARE
	help
	  pwm-audio-pi-zero overlay to get audio thanks to PWMs through GPIO Pins 18 and 13 on an Pi Zero equivalent to dtoverlay=pwm-2chan,pin=18,func=2,pin2=13,func2=4
```

## package/qtsixa-shanwan/Config.in
```kconfig
config BR2_PACKAGE_QTSIXA_SHANWAN
	depends on BR2_PACKAGE_QTSIXA
        bool "qtsixashanwan"
        help
          Support for ps3 controllers.


comment "qtsixashanwan depends on qtsixa"
	depends on !BR2_PACKAGE_QTSIXA
```

## package/qtsixa/Config.in
```kconfig
config BR2_PACKAGE_QTSIXA
	depends on BR2_PACKAGE_BLUEZ5_UTILS
	depends on BR2_PACKAGE_LIBUSB
	depends on BR2_PACKAGE_LIBUSB_COMPAT
        bool "qtsixa"
        help
          Support for ps3 controllers.


comment "qtsixa depends on bluez5_utils libusb libusb-compat"
	depends on !BR2_PACKAGE_BLUEZ5_UTILS || !BR2_PACKAGE_LIBUSB || !BR2_PACKAGE_LIBUSB_COMPAT
```

## package/recalbox-manager2/Config.in
```kconfig
config BR2_PACKAGE_RECALBOX_MANAGER2
	bool "recalbox-manager2"
	depends on BR2_PACKAGE_NODEJS
	help
	  A nodejs based web manager
	  https://github.com/djlechuck/recalbox-manager
```

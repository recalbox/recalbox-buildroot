## package/recalbox-romfs/recalbox-romfs-wswanc/Config.in
```kconfig
config BR2_PACKAGE_RECALBOX_ROMFS_WSWANC
	bool "recalbox-romfs-wswanc"
	select BR2_PACKAGE_RECALBOX_ROMS
	depends on BR2_PACKAGE_LIBRETRO_BEETLE_WSWAN
	help
	  share_init/roms and xml for wswanc
```

## package/recalbox-romfs/recalbox-romfs-zx81/Config.in
```kconfig
config BR2_PACKAGE_RECALBOX_ROMFS_ZX81
	bool "recalbox-romfs-zx81"
	select BR2_PACKAGE_RECALBOX_ROMS
	depends on BR2_PACKAGE_LIBRETRO_81
	help
	  share_init/roms and xml for zx81
```

## package/recalbox-romfs/recalbox-romfs-zxspectrum/Config.in
```kconfig
config BR2_PACKAGE_RECALBOX_ROMFS_ZXSPECTRUM
	bool "recalbox-romfs-zxspectrum"
	select BR2_PACKAGE_RECALBOX_ROMS
	depends on BR2_PACKAGE_LIBRETRO_FUSE
	help
	  share_init/roms and xml for zxspectrum
```

## package/recalbox-romfs/recalbox-romfs/Config.in
```kconfig
config BR2_PACKAGE_RECALBOX_ROMFS
	bool "recalbox-romfs"
	default y
	depends on BR2_PACKAGE_RECALBOX_ROMFS_AMSTRADCPC \
	  || BR2_PACKAGE_RECALBOX_ROMFS_APPLE2 \
	  || BR2_PACKAGE_RECALBOX_ROMFS_ATARI2600 \
	  || BR2_PACKAGE_RECALBOX_ROMFS_ATARI7800 \
	  || BR2_PACKAGE_RECALBOX_ROMFS_ATARIST \
	  || BR2_PACKAGE_RECALBOX_ROMFS_C64 \
	  || BR2_PACKAGE_RECALBOX_ROMFS_CAVESTORY \
	  || BR2_PACKAGE_RECALBOX_ROMFS_COLECOVISION \
	  || BR2_PACKAGE_RECALBOX_ROMFS_DOS \
	  || BR2_PACKAGE_RECALBOX_ROMFS_DREAMCAST \
	  || BR2_PACKAGE_RECALBOX_ROMFS_FBA \
	  || BR2_PACKAGE_RECALBOX_ROMFS_FBA_LIBRETRO \
	  || BR2_PACKAGE_RECALBOX_ROMFS_FDS \
	  || BR2_PACKAGE_RECALBOX_ROMFS_GAMECUBE \
	  || BR2_PACKAGE_RECALBOX_ROMFS_GAMEGEAR \
	  || BR2_PACKAGE_RECALBOX_ROMFS_GB \
	  || BR2_PACKAGE_RECALBOX_ROMFS_GBA \
	  || BR2_PACKAGE_RECALBOX_ROMFS_GBC \
	  || BR2_PACKAGE_RECALBOX_ROMFS_GW \
	  || BR2_PACKAGE_RECALBOX_ROMFS_IMAGEVIEWER \
	  || BR2_PACKAGE_RECALBOX_ROMFS_LUTRO \
	  || BR2_PACKAGE_RECALBOX_ROMFS_LYNX \
	  || BR2_PACKAGE_RECALBOX_ROMFS_MAME \
	  || BR2_PACKAGE_RECALBOX_ROMFS_MASTERSYSTEM \
	  || BR2_PACKAGE_RECALBOX_ROMFS_MEGADRIVE \
	  || BR2_PACKAGE_RECALBOX_ROMFS_MOONLIGHT \
	  || BR2_PACKAGE_RECALBOX_ROMFS_MSX \
	  || BR2_PACKAGE_RECALBOX_ROMFS_MSX1 \
	  || BR2_PACKAGE_RECALBOX_ROMFS_MSX2 \
	  || BR2_PACKAGE_RECALBOX_ROMFS_N64 \
	  || BR2_PACKAGE_RECALBOX_ROMFS_NEOGEO \
	  || BR2_PACKAGE_RECALBOX_ROMFS_NES \
	  || BR2_PACKAGE_RECALBOX_ROMFS_NGP \
	  || BR2_PACKAGE_RECALBOX_ROMFS_NGPC \
	  || BR2_PACKAGE_RECALBOX_ROMFS_O2EM \
	  || BR2_PACKAGE_RECALBOX_ROMFS_PCENGINE \
	  || BR2_PACKAGE_RECALBOX_ROMFS_PCENGINECD \
	  || BR2_PACKAGE_RECALBOX_ROMFS_PRBOOM \
	  || BR2_PACKAGE_RECALBOX_ROMFS_PSP \
	  || BR2_PACKAGE_RECALBOX_ROMFS_PSX \
	  || BR2_PACKAGE_RECALBOX_ROMFS_SCUMMVM \
	  || BR2_PACKAGE_RECALBOX_ROMFS_SEGA32X \
	  || BR2_PACKAGE_RECALBOX_ROMFS_SEGACD \
	  || BR2_PACKAGE_RECALBOX_ROMFS_SG1000 \
	  || BR2_PACKAGE_RECALBOX_ROMFS_SNES \
	  || BR2_PACKAGE_RECALBOX_ROMFS_SUPERGRAFX \
	  || BR2_PACKAGE_RECALBOX_ROMFS_VECTREX \
	  || BR2_PACKAGE_RECALBOX_ROMFS_VIRTUALBOY \
	  || BR2_PACKAGE_RECALBOX_ROMFS_WII \
	  || BR2_PACKAGE_RECALBOX_ROMFS_WSWAN \
	  || BR2_PACKAGE_RECALBOX_ROMFS_WSWANC \
	  || BR2_PACKAGE_RECALBOX_ROMFS_ZX81 \
	  || BR2_PACKAGE_RECALBOX_ROMFS_ZXSPECTRUM

	help
	  This super package will create the share_init/roms structure
	  as well as the es_systems.cfg depending on emulators
```

## package/reicast/Config.in
```kconfig
config BR2_PACKAGE_REICAST
	bool "reicast"
	depends on BR2_PACKAGE_SDL2
	depends on BR2_PACKAGE_LIBPNG
	select BR2_PACKAGE_RECALBOX_ROMFS_DREAMCAST
	help
	  A  Dreamcast emulator
```

## package/rgb-pi/Config.in
```kconfig
config BR2_PACKAGE_RGB_PI
	bool "rgb-pi"
	depends on BR2_PACKAGE_RPI_FIRMWARE
	help
	  A DTBO combining VGA 565 and PWM audio
```

## package/rpi-fbcp/Config.in
```kconfig
config BR2_PACKAGE_RPI_FBCP
    bool "rpi-fbcp"
    depends on BR2_PACKAGE_TFT_WAVESHARE
    help
		Raspberry Pi utility. Used for mirror primary framebuffer to secondary framebuffer.

		https://github.com/ian57/rpi-fbcp fork from https://github.com/tasanakorn/rpi-fbcp
```

## package/steamcontroller/Config.in
```kconfig
config BR2_PACKAGE_STEAMCONTROLLER
        bool "steam controller driver"
	depends on BR2_PACKAGE_PYTHON
	select BR2_PACKAGE_PYTHON_ENUM34
	select BR2_PACKAGE_PYTHON_LIBUSB1
        help
	  Steam Controller Support
	  https://github.com/ynsta/steamcontroller
```

## package/tft-waveshare/Config.in
```kconfig
config BR2_PACKAGE_TFT_WAVESHARE
	bool "tft-waveshare"
	depends on BR2_PACKAGE_RPI_FIRMWARE
	help
	  DTBO files to give support of 3.2 and 3.5 TFT Waveshare Screen
```

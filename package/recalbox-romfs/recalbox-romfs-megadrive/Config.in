## package/recalbox-romfs/recalbox-romfs-megadrive/Config.in
```kconfig
config BR2_PACKAGE_RECALBOX_ROMFS_MEGADRIVE
	bool "recalbox-romfs-megadrive"
	select BR2_PACKAGE_RECALBOX_ROMS
	depends on BR2_PACKAGE_LIBRETRO_GENESISPLUSGX \
	  || BR2_PACKAGE_LIBRETRO_PICODRIVE
	help
	  share_init/roms and xml for megadrive
```

## package/recalbox-romfs/recalbox-romfs-moonlight/Config.in
```kconfig
config BR2_PACKAGE_RECALBOX_ROMFS_MOONLIGHT
	bool "recalbox-romfs-moonlight"
	select BR2_PACKAGE_RECALBOX_ROMS
	depends on BR2_PACKAGE_MOONLIGHT_EMBEDDED
	help
	  share_init/roms and xml for moonlight
```

## package/recalbox-romfs/recalbox-romfs-msx/Config.in
```kconfig
config BR2_PACKAGE_RECALBOX_ROMFS_MSX
	bool "recalbox-romfs-msx"
	select BR2_PACKAGE_RECALBOX_ROMS
	depends on BR2_PACKAGE_LIBRETRO_BLUEMSX
	help
	  share_init/roms and xml for msx
```

## package/recalbox-romfs/recalbox-romfs-msx1/Config.in
```kconfig
config BR2_PACKAGE_RECALBOX_ROMFS_MSX1
	bool "recalbox-romfs-msx1"
	select BR2_PACKAGE_RECALBOX_ROMS
	depends on BR2_PACKAGE_LIBRETRO_BLUEMSX
	help
	  share_init/roms and xml for msx1
```

## package/recalbox-romfs/recalbox-romfs-msx2/Config.in
```kconfig
config BR2_PACKAGE_RECALBOX_ROMFS_MSX2
	bool "recalbox-romfs-msx2"
	select BR2_PACKAGE_RECALBOX_ROMS
	depends on BR2_PACKAGE_LIBRETRO_BLUEMSX
	help
	  share_init/roms and xml for msx2
```

## package/recalbox-romfs/recalbox-romfs-n64/Config.in
```kconfig
config BR2_PACKAGE_RECALBOX_ROMFS_N64
	bool "recalbox-romfs-n64"
	select BR2_PACKAGE_RECALBOX_ROMS
	depends on BR2_PACKAGE_MUPEN64PLUS_GLIDEN64 \
	  || BR2_PACKAGE_MUPEN64PLUS_GLES2 \
	  || BR2_PACKAGE_MUPEN64PLUS_GLES2RICE \
	  || BR2_PACKAGE_MUPEN64PLUS_VIDEO_GLIDE64MK2 \
	  || BR2_PACKAGE_LIBRETRO_GLUPEN64
	help
	  share_init/roms and xml for n64
```

## package/recalbox-romfs/recalbox-romfs-nes/Config.in
```kconfig
config BR2_PACKAGE_RECALBOX_ROMFS_NES
	bool "recalbox-romfs-nes"
	select BR2_PACKAGE_RECALBOX_ROMS
	depends on BR2_PACKAGE_LIBRETRO_FCEUMM \
	  || BR2_PACKAGE_LIBRETRO_FCEUNEXT \
	  || BR2_PACKAGE_LIBRETRO_NESTOPIA \
	  || BR2_PACKAGE_LIBRETRO_QUICKNES
	help
	  share_init/roms and xml for nes
```

## package/recalbox-romfs/recalbox-romfs-ngp/Config.in
```kconfig
config BR2_PACKAGE_RECALBOX_ROMFS_NGP
	bool "recalbox-romfs-ngp"
	select BR2_PACKAGE_RECALBOX_ROMS
	depends on BR2_PACKAGE_LIBRETRO_BEETLE_NGP
	help
	  share_init/roms and xml for ngp
```

## package/recalbox-romfs/recalbox-romfs-ngpc/Config.in
```kconfig
config BR2_PACKAGE_RECALBOX_ROMFS_NGPC
	bool "recalbox-romfs-ngpc"
	select BR2_PACKAGE_RECALBOX_ROMS
	depends on BR2_PACKAGE_LIBRETRO_BEETLE_NGP
	help
	  share_init/roms and xml for ngpc
```

## package/recalbox-romfs/recalbox-romfs-o2em/Config.in
```kconfig
config BR2_PACKAGE_RECALBOX_ROMFS_O2EM
	bool "recalbox-romfs-o2em"
	select BR2_PACKAGE_RECALBOX_ROMS
	depends on BR2_PACKAGE_LIBRETRO_O2EM
	help
	  share_init/roms and xml for o2em
```

## package/recalbox-romfs/recalbox-romfs-pcengine/Config.in
```kconfig
config BR2_PACKAGE_RECALBOX_ROMFS_PCENGINE
	bool "recalbox-romfs-pcengine"
	select BR2_PACKAGE_RECALBOX_ROMS
	depends on BR2_PACKAGE_LIBRETRO_BEETLE_SUPERGRAFX \
	  || BR2_PACKAGE_LIBRETRO_BEETLE_PCE
	help
	  share_init/roms and xml for pcengine
```

## package/recalbox-romfs/recalbox-romfs-pcenginecd/Config.in
```kconfig
config BR2_PACKAGE_RECALBOX_ROMFS_PCENGINECD
	bool "recalbox-romfs-pcenginecd"
	select BR2_PACKAGE_RECALBOX_ROMS
	depends on BR2_PACKAGE_LIBRETRO_BEETLE_SUPERGRAFX \
	  || BR2_PACKAGE_LIBRETRO_BEETLE_PCE
	help
	  share_init/roms and xml for pcenginecd
```

## package/recalbox-romfs/recalbox-romfs-prboom/Config.in
```kconfig
config BR2_PACKAGE_RECALBOX_ROMFS_PRBOOM
	bool "recalbox-romfs-prboom"
	select BR2_PACKAGE_RECALBOX_ROMS
	depends on BR2_PACKAGE_LIBRETRO_PRBOOM
	help
	  share_init/roms and xml for prboom
```

## package/recalbox-romfs/recalbox-romfs-psp/Config.in
```kconfig
config BR2_PACKAGE_RECALBOX_ROMFS_PSP
	bool "recalbox-romfs-psp"
	select BR2_PACKAGE_RECALBOX_ROMS
	depends on BR2_PACKAGE_PPSSPP
	help
	  share_init/roms and xml for psp
```

## package/recalbox-romfs/recalbox-romfs-psx/Config.in
```kconfig
config BR2_PACKAGE_RECALBOX_ROMFS_PSX
	bool "recalbox-romfs-psx"
	select BR2_PACKAGE_RECALBOX_ROMS
	depends on BR2_PACKAGE_LIBRETRO_PCSX
	help
	  share_init/roms and xml for psx
```

## package/recalbox-romfs/recalbox-romfs-scummvm/Config.in
```kconfig
config BR2_PACKAGE_RECALBOX_ROMFS_SCUMMVM
	bool "recalbox-romfs-scummvm"
	select BR2_PACKAGE_RECALBOX_ROMS
	depends on BR2_PACKAGE_SCUMMVM
	help
	  share_init/roms and xml for scummvm
```

## package/recalbox-romfs/recalbox-romfs-sega32x/Config.in
```kconfig
config BR2_PACKAGE_RECALBOX_ROMFS_SEGA32X
	bool "recalbox-romfs-sega32x"
	select BR2_PACKAGE_RECALBOX_ROMS
	depends on BR2_PACKAGE_LIBRETRO_PICODRIVE
	help
	  share_init/roms and xml for sega32x
```

## package/recalbox-romfs/recalbox-romfs-segacd/Config.in
```kconfig
config BR2_PACKAGE_RECALBOX_ROMFS_SEGACD
	bool "recalbox-romfs-segacd"
	select BR2_PACKAGE_RECALBOX_ROMS
	depends on BR2_PACKAGE_LIBRETRO_GENESISPLUSGX \
	  || BR2_PACKAGE_LIBRETRO_PICODRIVE
	help
	  share_init/roms and xml for segacd
```

## package/recalbox-romfs/recalbox-romfs-sg1000/Config.in
```kconfig
config BR2_PACKAGE_RECALBOX_ROMFS_SG1000
	bool "recalbox-romfs-sg1000"
	select BR2_PACKAGE_RECALBOX_ROMS
	depends on BR2_PACKAGE_LIBRETRO_GENESISPLUSGX \
	  || BR2_PACKAGE_LIBRETRO_PICODRIVE
	help
	  share_init/roms and xml for sg1000
```

## package/recalbox-romfs/recalbox-romfs-snes/Config.in
```kconfig
config BR2_PACKAGE_RECALBOX_ROMFS_SNES
	bool "recalbox-romfs-snes"
	select BR2_PACKAGE_RECALBOX_ROMS
	depends on BR2_PACKAGE_LIBRETRO_CATSFC \
	  || BR2_PACKAGE_LIBRETRO_POCKETSNES \
	  || BR2_PACKAGE_LIBRETRO_SNES9X_NEXT \
	  || BR2_PACKAGE_LIBRETRO_SNES9X
	help
	  share_init/roms and xml for snes
```

## package/recalbox-romfs/recalbox-romfs-supergrafx/Config.in
```kconfig
config BR2_PACKAGE_RECALBOX_ROMFS_SUPERGRAFX
	bool "recalbox-romfs-supergrafx"
	select BR2_PACKAGE_RECALBOX_ROMS
	depends on BR2_PACKAGE_LIBRETRO_BEETLE_SUPERGRAFX \
	  || BR2_PACKAGE_LIBRETRO_BEETLE_PCE
	help
	  share_init/roms and xml for supergrafx
```

## package/recalbox-romfs/recalbox-romfs-vectrex/Config.in
```kconfig
config BR2_PACKAGE_RECALBOX_ROMFS_VECTREX
	bool "recalbox-romfs-vectrex"
	select BR2_PACKAGE_RECALBOX_ROMS
	depends on BR2_PACKAGE_LIBRETRO_VECX
	help
	  share_init/roms and xml for vectrex
```

## package/recalbox-romfs/recalbox-romfs-virtualboy/Config.in
```kconfig
config BR2_PACKAGE_RECALBOX_ROMFS_VIRTUALBOY
	bool "recalbox-romfs-virtualboy"
	select BR2_PACKAGE_RECALBOX_ROMS
	depends on BR2_PACKAGE_LIBRETRO_BEETLE_VB
	help
	  share_init/roms and xml for virtualboy
```

## package/recalbox-romfs/recalbox-romfs-wii/Config.in
```kconfig
config BR2_PACKAGE_RECALBOX_ROMFS_WII
	bool "recalbox-romfs-wii"
	select BR2_PACKAGE_RECALBOX_ROMS
	depends on BR2_PACKAGE_DOLPHIN_EMU
	help
	  share_init/roms and xml for wii
```

## package/recalbox-romfs/recalbox-romfs-wswan/Config.in
```kconfig
config BR2_PACKAGE_RECALBOX_ROMFS_WSWAN
	bool "recalbox-romfs-wswan"
	select BR2_PACKAGE_RECALBOX_ROMS
	depends on BR2_PACKAGE_LIBRETRO_BEETLE_WSWAN
	help
	  share_init/roms and xml for wswan
```

## package/recalbox-romfs/Config.in
```kconfig
# Recalbox-roms main package
source "package/recalbox-romfs/recalbox-romfs/Config.in"

# if BR2_PACKAGE_RECALBOX_ROMFS
menu "Rom dirs and xml"
	source "package/recalbox-romfs/recalbox-romfs-amstradcpc/Config.in"
	source "package/recalbox-romfs/recalbox-romfs-apple2/Config.in"
	source "package/recalbox-romfs/recalbox-romfs-atari2600/Config.in"
	source "package/recalbox-romfs/recalbox-romfs-atari7800/Config.in"
	source "package/recalbox-romfs/recalbox-romfs-atarist/Config.in"
	source "package/recalbox-romfs/recalbox-romfs-c64/Config.in"
	source "package/recalbox-romfs/recalbox-romfs-cavestory/Config.in"
	source "package/recalbox-romfs/recalbox-romfs-colecovision/Config.in"
	source "package/recalbox-romfs/recalbox-romfs-dos/Config.in"
	source "package/recalbox-romfs/recalbox-romfs-dreamcast/Config.in"
	source "package/recalbox-romfs/recalbox-romfs-fba/Config.in"
	source "package/recalbox-romfs/recalbox-romfs-fba_libretro/Config.in"
	source "package/recalbox-romfs/recalbox-romfs-fds/Config.in"
	source "package/recalbox-romfs/recalbox-romfs-gamecube/Config.in"
	source "package/recalbox-romfs/recalbox-romfs-gamegear/Config.in"
	source "package/recalbox-romfs/recalbox-romfs-gb/Config.in"
	source "package/recalbox-romfs/recalbox-romfs-gba/Config.in"
	source "package/recalbox-romfs/recalbox-romfs-gbc/Config.in"
	source "package/recalbox-romfs/recalbox-romfs-gw/Config.in"
	source "package/recalbox-romfs/recalbox-romfs-imageviewer/Config.in"
	source "package/recalbox-romfs/recalbox-romfs-lutro/Config.in"
	source "package/recalbox-romfs/recalbox-romfs-lynx/Config.in"
	source "package/recalbox-romfs/recalbox-romfs-mame/Config.in"
	source "package/recalbox-romfs/recalbox-romfs-mastersystem/Config.in"
	source "package/recalbox-romfs/recalbox-romfs-megadrive/Config.in"
	source "package/recalbox-romfs/recalbox-romfs-moonlight/Config.in"
	source "package/recalbox-romfs/recalbox-romfs-msx/Config.in"
	source "package/recalbox-romfs/recalbox-romfs-msx1/Config.in"
	source "package/recalbox-romfs/recalbox-romfs-msx2/Config.in"
	source "package/recalbox-romfs/recalbox-romfs-n64/Config.in"
	source "package/recalbox-romfs/recalbox-romfs-neogeo/Config.in"
	source "package/recalbox-romfs/recalbox-romfs-nes/Config.in"
	source "package/recalbox-romfs/recalbox-romfs-ngp/Config.in"
	source "package/recalbox-romfs/recalbox-romfs-ngpc/Config.in"
	source "package/recalbox-romfs/recalbox-romfs-o2em/Config.in"
	source "package/recalbox-romfs/recalbox-romfs-pcengine/Config.in"
	source "package/recalbox-romfs/recalbox-romfs-pcenginecd/Config.in"
	source "package/recalbox-romfs/recalbox-romfs-prboom/Config.in"
	source "package/recalbox-romfs/recalbox-romfs-psp/Config.in"
	source "package/recalbox-romfs/recalbox-romfs-psx/Config.in"
	source "package/recalbox-romfs/recalbox-romfs-scummvm/Config.in"
	source "package/recalbox-romfs/recalbox-romfs-sega32x/Config.in"
	source "package/recalbox-romfs/recalbox-romfs-segacd/Config.in"
	source "package/recalbox-romfs/recalbox-romfs-sg1000/Config.in"
	source "package/recalbox-romfs/recalbox-romfs-snes/Config.in"
	source "package/recalbox-romfs/recalbox-romfs-supergrafx/Config.in"
	source "package/recalbox-romfs/recalbox-romfs-vectrex/Config.in"
	source "package/recalbox-romfs/recalbox-romfs-virtualboy/Config.in"
	source "package/recalbox-romfs/recalbox-romfs-wii/Config.in"
	source "package/recalbox-romfs/recalbox-romfs-wswan/Config.in"
	source "package/recalbox-romfs/recalbox-romfs-wswanc/Config.in"
	source "package/recalbox-romfs/recalbox-romfs-zx81/Config.in"
	source "package/recalbox-romfs/recalbox-romfs-zxspectrum/Config.in"
endmenu
# endif
```

## package/recalbox-romfs/recalbox-romfs-amstradcpc/Config.in
```kconfig
config BR2_PACKAGE_RECALBOX_ROMFS_AMSTRADCPC
	bool "recalbox-romfs-amstradcpc"
	select BR2_PACKAGE_RECALBOX_ROMS
	depends on BR2_PACKAGE_LIBRETRO_CAP32
	help
	  share_init/roms and xml for amstradcpc
```

## package/recalbox-romfs/recalbox-romfs-apple2/Config.in
```kconfig
config BR2_PACKAGE_RECALBOX_ROMFS_APPLE2
	bool "recalbox-romfs-apple2"
	select BR2_PACKAGE_RECALBOX_ROMS
	depends on BR2_PACKAGE_LINAPPLE_PIE
	help
	  share_init/roms and xml for apple2
```

## package/recalbox-romfs/recalbox-romfs-atari2600/Config.in
```kconfig
config BR2_PACKAGE_RECALBOX_ROMFS_ATARI2600
	bool "recalbox-romfs-atari2600"
	select BR2_PACKAGE_RECALBOX_ROMS
	depends on BR2_PACKAGE_LIBRETRO_STELLA
	help
	  share_init/roms and xml for atari2600
```

## package/recalbox-romfs/recalbox-romfs-atari7800/Config.in
```kconfig
config BR2_PACKAGE_RECALBOX_ROMFS_ATARI7800
	bool "recalbox-romfs-atari7800"
	select BR2_PACKAGE_RECALBOX_ROMS
	depends on BR2_PACKAGE_LIBRETRO_PROSYSTEM
	help
	  share_init/roms and xml for atari7800
```

## package/recalbox-romfs/recalbox-romfs-atarist/Config.in
```kconfig
config BR2_PACKAGE_RECALBOX_ROMFS_ATARIST
	bool "recalbox-romfs-atarist"
	select BR2_PACKAGE_RECALBOX_ROMS
	depends on BR2_PACKAGE_LIBRETRO_HATARI
	help
	  share_init/roms and xml for atarist
```

## package/recalbox-romfs/recalbox-romfs-c64/Config.in
```kconfig
config BR2_PACKAGE_RECALBOX_ROMFS_C64
	bool "recalbox-romfs-c64"
	select BR2_PACKAGE_RECALBOX_ROMS
	depends on BR2_PACKAGE_VICE
	help
	  share_init/roms and xml for c64
```

## package/recalbox-romfs/recalbox-romfs-cavestory/Config.in
```kconfig
config BR2_PACKAGE_RECALBOX_ROMFS_CAVESTORY
	bool "recalbox-romfs-cavestory"
	select BR2_PACKAGE_RECALBOX_ROMS
	depends on BR2_PACKAGE_LIBRETRO_NXENGINE
	help
	  share_init/roms and xml for cavestory
```

## package/recalbox-romfs/recalbox-romfs-colecovision/Config.in
```kconfig
config BR2_PACKAGE_RECALBOX_ROMFS_COLECOVISION
	bool "recalbox-romfs-colecovision"
	select BR2_PACKAGE_RECALBOX_ROMS
	depends on BR2_PACKAGE_LIBRETRO_BLUEMSX
	help
	  share_init/roms and xml for colecovision
```

## package/recalbox-romfs/recalbox-romfs-dos/Config.in
```kconfig
config BR2_PACKAGE_RECALBOX_ROMFS_DOS
	bool "recalbox-romfs-dos"
	select BR2_PACKAGE_RECALBOX_ROMS
	depends on BR2_PACKAGE_DOSBOX
	help
	  share_init/roms and xml for dos
```

## package/recalbox-romfs/recalbox-romfs-dreamcast/Config.in
```kconfig
config BR2_PACKAGE_RECALBOX_ROMFS_DREAMCAST
	bool "recalbox-romfs-dreamcast"
	select BR2_PACKAGE_RECALBOX_ROMS
	depends on BR2_PACKAGE_REICAST
	help
	  share_init/roms and xml for dreamcast
```

## package/recalbox-romfs/recalbox-romfs-fba/Config.in
```kconfig
config BR2_PACKAGE_RECALBOX_ROMFS_FBA
	bool "recalbox-romfs-fba"
	select BR2_PACKAGE_RECALBOX_ROMS
	depends on BR2_PACKAGE_LIBRETRO_FBA \
	  || BR2_PACKAGE_PIFBA
	help
	  share_init/roms and xml for fba
```

## package/recalbox-romfs/recalbox-romfs-fba_libretro/Config.in
```kconfig
config BR2_PACKAGE_RECALBOX_ROMFS_FBA_LIBRETRO
	bool "recalbox-romfs-fba_libretro"
	select BR2_PACKAGE_RECALBOX_ROMS
	depends on BR2_PACKAGE_LIBRETRO_FBA
	help
	  share_init/roms and xml for fba_libretro
```

## package/recalbox-romfs/recalbox-romfs-fds/Config.in
```kconfig
config BR2_PACKAGE_RECALBOX_ROMFS_FDS
	bool "recalbox-romfs-fds"
	select BR2_PACKAGE_RECALBOX_ROMS
	depends on BR2_PACKAGE_LIBRETRO_FCEUMM \
	  || BR2_PACKAGE_LIBRETRO_NESTOPIA
	help
	  share_init/roms and xml for fds
```

## package/recalbox-romfs/recalbox-romfs-gamecube/Config.in
```kconfig
config BR2_PACKAGE_RECALBOX_ROMFS_GAMECUBE
	bool "recalbox-romfs-gamecube"
	select BR2_PACKAGE_RECALBOX_ROMS
	depends on BR2_PACKAGE_DOLPHIN_EMU
	help
	  share_init/roms and xml for gamecube
```

## package/recalbox-romfs/recalbox-romfs-gamegear/Config.in
```kconfig
config BR2_PACKAGE_RECALBOX_ROMFS_GAMEGEAR
	bool "recalbox-romfs-gamegear"
	select BR2_PACKAGE_RECALBOX_ROMS
	depends on BR2_PACKAGE_LIBRETRO_GENESISPLUSGX \
	  || BR2_PACKAGE_LIBRETRO_PICODRIVE
	help
	  share_init/roms and xml for gamegear
```

## package/recalbox-romfs/recalbox-romfs-gb/Config.in
```kconfig
config BR2_PACKAGE_RECALBOX_ROMFS_GB
	bool "recalbox-romfs-gb"
	select BR2_PACKAGE_RECALBOX_ROMS
	depends on BR2_PACKAGE_LIBRETRO_GAMBATTE \
	  || BR2_PACKAGE_LIBRETRO_TGBDUAL
	help
	  share_init/roms and xml for gb
```

## package/recalbox-romfs/recalbox-romfs-gba/Config.in
```kconfig
config BR2_PACKAGE_RECALBOX_ROMFS_GBA
	bool "recalbox-romfs-gba"
	select BR2_PACKAGE_RECALBOX_ROMS
	depends on BR2_PACKAGE_LIBRETRO_GPSP \
	  || BR2_PACKAGE_LIBRETRO_MGBA \
	  || BR2_PACKAGE_LIBRETRO_METEOR
	help
	  share_init/roms and xml for gba
```

## package/recalbox-romfs/recalbox-romfs-gbc/Config.in
```kconfig
config BR2_PACKAGE_RECALBOX_ROMFS_GBC
	bool "recalbox-romfs-gbc"
	select BR2_PACKAGE_RECALBOX_ROMS
	depends on BR2_PACKAGE_LIBRETRO_GAMBATTE \
	  || BR2_PACKAGE_LIBRETRO_TGBDUAL
	help
	  share_init/roms and xml for gbc
```

## package/recalbox-romfs/recalbox-romfs-gw/Config.in
```kconfig
config BR2_PACKAGE_RECALBOX_ROMFS_GW
	bool "recalbox-romfs-gw"
	select BR2_PACKAGE_RECALBOX_ROMS
	depends on BR2_PACKAGE_LIBRETRO_GW
	help
	  share_init/roms and xml for gw
```

## package/recalbox-romfs/recalbox-romfs-imageviewer/Config.in
```kconfig
config BR2_PACKAGE_RECALBOX_ROMFS_IMAGEVIEWER
	bool "recalbox-romfs-imageviewer"
	select BR2_PACKAGE_RECALBOX_ROMS
	depends on BR2_PACKAGE_RETROARCH
	help
	  share_init/roms and xml for imageviewer
```

## package/recalbox-romfs/recalbox-romfs-lutro/Config.in
```kconfig
config BR2_PACKAGE_RECALBOX_ROMFS_LUTRO
	bool "recalbox-romfs-lutro"
	select BR2_PACKAGE_RECALBOX_ROMS
	depends on BR2_PACKAGE_LIBRETRO_LUTRO
	help
	  share_init/roms and xml for lutro
```

## package/recalbox-romfs/recalbox-romfs-lynx/Config.in
```kconfig
config BR2_PACKAGE_RECALBOX_ROMFS_LYNX
	bool "recalbox-romfs-lynx"
	select BR2_PACKAGE_RECALBOX_ROMS
	depends on BR2_PACKAGE_LIBRETRO_BEETLE_LYNX
	help
	  share_init/roms and xml for lynx
```

## package/recalbox-romfs/recalbox-romfs-mame/Config.in
```kconfig
config BR2_PACKAGE_RECALBOX_ROMFS_MAME
	bool "recalbox-romfs-mame"
	select BR2_PACKAGE_RECALBOX_ROMS
	depends on BR2_PACKAGE_LIBRETRO_MAME2003 \
	  || BR2_PACKAGE_LIBRETRO_IMAME \
	  || BR2_PACKAGE_ADVANCEMAME
	help
	  share_init/roms and xml for mame
```

## package/recalbox-romfs/recalbox-romfs-mastersystem/Config.in
```kconfig
config BR2_PACKAGE_RECALBOX_ROMFS_MASTERSYSTEM
	bool "recalbox-romfs-mastersystem"
	select BR2_PACKAGE_RECALBOX_ROMS
	depends on BR2_PACKAGE_LIBRETRO_GENESISPLUSGX \
	  || BR2_PACKAGE_LIBRETRO_PICODRIVE
	help
	  share_init/roms and xml for mastersystem
```
